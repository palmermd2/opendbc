VERSION ""

NS_ :

BS_:

BU_: XXX

BO_ 2 two: 8 XXX
 SG_ NEW_SIGNAL_1 : 7|8@0+ (1,0) [0|255] "" XXX

BO_ 768 Steering: 8 XXX
 SG_ steeringTorque : 7|8@0+ (1,0) [0|255] "" XXX

BO_ 640 seatbelts: 8 XXX
 SG_ DriverSeatbelt : 1|1@0+ (1,0) [0|1] "" XXX
 SG_ passSeatbelt : 0|1@0+ (1,0) [0|1] "" XXX

BO_ 304 oneThirty: 8 XXX
 SG_ oneThirty_zero : 7|8@0+ (1,0) [0|255] "" XXX
