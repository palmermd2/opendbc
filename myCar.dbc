VERSION ""

NS_ :

BS_:

BU_: XXX 1

BO_ 2 steering: 8 XXX
 SG_ NEW_SIGNAL_3 : 39|8@0+ (1,0) [0|255] "neo" XXX

BO_ 768 Steering: 8 XXX
 SG_ steeringTorque : 7|8@0+ (1,0) [0|255] "" XXX

BO_ 640 seatbelts: 8 XXX
 SG_ DriverSeatbelt : 1|1@0+ (1,0) [0|1] "" XXX
 SG_ passSeatbelt : 0|1@0+ (1,0) [0|1] "" XXX

BO_ 304 oneThirty: 8 XXX
 SG_ oneThirty_zero : 7|8@0+ (1,0) [0|255] "myunit" XXX

BO_ 644 speeds: 8 XXX

BO_ 469 brake: 8 XXX

BO_ 372 PRNDL: 8 XXX
 SG_ reverse : 25|1@0+ (1,0) [0|1] "" XXX
 SG_ park : 24|1@0+ (1,0) [0|1] "" XXX

BO_ 459 brake: 8 XXX

CM_ SG_ 2 NEW_SIGNAL_3 "steering";
CM_ SG_ 304 oneThirty_zero "neo";
