VERSION ""

NS_ :

BS_:

BU_: XXX 1

BO_ 2 steering: 8 XXX
 SG_ steering angle : 7|16@0+ (1,0) [0|65535] "" XXX

BO_ 768 Steering: 8 XXX
 SG_ steeringTorque : 7|8@0+ (1,0) [0|255] "" XXX

BO_ 640 seatbelts: 8 XXX
 SG_ DriverSeatbelt : 1|1@0+ (1,0) [0|1] "" XXX
 SG_ passSeatbelt : 0|1@0+ (1,0) [0|1] "" XXX

BO_ 304 oneThirty: 8 XXX
 SG_ oneThirty_zero : 7|8@0+ (1,0) [0|255] "" XXX

BO_ 644 speeds: 8 XXX
 SG_ v : NaN|NaN@0+ (NaN,NaN) [3|9] "," 1

BO_ 469 brake: 8 XXX
 SG_ t : 0|0@0+ (0,0) [0|7] "," 1
 SG_ regen target ? : 7|16@0+ (1,0) [0|65535] "" XXX
