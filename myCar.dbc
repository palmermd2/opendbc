VERSION ""

NS_ :

BS_:

BU_: XXX 1

BO_ 2 two: 8 XXX
 SG_ NEW_SIGNAL_1 : 7|8@0+ (1,0) [0|255] "" XXX

BO_ 768 Steering: 8 XXX
 SG_ steeringTorque : 7|8@0+ (1,0) [0|255] "" XXX

BO_ 640 seatbelts: 8 XXX
 SG_ DriverSeatbelt : 1|1@0+ (1,0) [0|1] "" XXX
 SG_ passSeatbelt : 0|1@0+ (1,0) [0|1] "" XXX

BO_ 304 oneThirty: 8 XXX
 SG_ oneThirty_zero : 7|8@0+ (1,0) [0|255] "" XXX

BO_ 644 speeds: 8 XXX
 SG_ wheel speed 1 : 7|16@0+ (1,0) [0|65535] "" XXX
 SG_ wheel speed 2 : 23|16@0+ (1,0) [0|65535] "" XXX
 SG_ vehicle speed : 39|16@0+ (1,0) [0|65535] "" XXX

BO_ 645 speeds 2: 8 XXX
 SG_ rear wheel 1 : 7|16@0+ (1,0) [0|65535] "" XXX
 SG_ rear wheel 2 : 23|16@0+ (1,0) [0|65535] "" XXX
 SG_ clock? : 55|16@0+ (1,0) [0|65535] "" XXX
